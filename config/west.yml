## config/west.yml
```yaml
manifest:
  remotes:
    - name: jonz94
      url-base: https://github.com/jonz94
  projects:
    - name: zmk
      remote: jonz94
      revision: main
      import: app/west.yml
  self:
    path: config
```
